## buildroot_external/Config.in
```kconfig
source "$BR2_EXTERNAL_HRWILC_PATH/package/wilc-firmware/Config.in"
source "$BR2_EXTERNAL_HRWILC_PATH/package/websocket/Config.in"
source "$BR2_EXTERNAL_HRWILC_PATH/package/bt_app/Config.in"

source "$BR2_EXTERNAL_HRWILC_PATH/package/python-awsiotpythonsdk/Config.in"
source "$BR2_EXTERNAL_HRWILC_PATH/package/azure-iot-sdk-python/Config.in"
source "$BR2_EXTERNAL_HRWILC_PATH/package/python-hrclickboard/Config.in"
source "$BR2_EXTERNAL_HRWILC_PATH/package/python-statistics/Config.in"

source "$BR2_EXTERNAL_HRWILC_PATH/package/python-pip/Config.in"
```

## buildroot_external/package/Config.in
```kconfig
source "package/wilc-firmware/Config.in"
source "package/websocket/Config.in"
source "package/bt_app/Config.in"

source "package/python-awsiotpythonsdk/Config.in"
source "package/azure-iot-sdk-python/Config.in"
source "package/python-hrclickboard/Config.in" 
source "package/python-statistics/Config.in"

source "package/python-pip/Config.in"
```

## buildroot_external/package/azure-iot-sdk-python/Config.in
```kconfig
config BR2_PACKAGE_AZURE_IOT_SDK_PYTHON
	bool "azure-iot-sdk-python"
	depends on BR2_INSTALL_LIBSTDCPP
	depends on BR2_TOOLCHAIN_HAS_THREADS_NPTL
	select BR2_PACKAGE_LIBCURL
	select BR2_PACKAGE_LIBXML2
	select BR2_PACKAGE_OPENSSL
	select BR2_PACKAGE_UTIL_LINUX
	select BR2_PACKAGE_UTIL_LINUX_LIBUUID
	select BR2_PACKAGE_BOOST
	select BR2_PACKAGE_BOOST_PYTHON

	help
	  Microsoft Azure IoT Hub device SDK for C wrapped in python is used
	  to easily connect devices using python code to Azure IoT Hub.
```

## buildroot_external/package/python-awsiotpythonsdk/Config.in
```kconfig
config BR2_PACKAGE_PYTHON_AWSIOTPYTHONSDK
	bool "python-awsiotpythonsdk"
	help
	  SDK for connecting to AWS IoT using Python.

	  https://github.com/aws/aws-iot-device-sdk-python.git
```

## buildroot_external/package/python-hrclickboard/Config.in
```kconfig
config BR2_PACKAGE_PYTHON_HRCLICKBOARD
	bool "python-hrclickboard"
	select BR2_PACKAGE_PYTHON_STATISTICS
	help
	  SDK for communicating with Heart Rate click board.
```

## buildroot_external/package/python-statistics/Config.in
```kconfig
config BR2_PACKAGE_PYTHON_STATISTICS
	bool "python-statistics"
	select BR2_PACKAGE_PYTHON_DOCUTILS # runtime
	help
	  A Python 2.* port of 3.4 Statistics Module.

	  UNKNOWN
```

## buildroot_external/package/wilc-firmware/Config.in
```kconfig
config BR2_PACKAGE_WILC_FIRMWARE
	bool "wilc-firmware"
	help
	  Firmware for Atmel Wilc1000/3000 wireless device

	  https://github.com/linux4wilc/firmware/releases
```
